		AREA    |.text|, CODE, READONLY

GPIO_PORTD_BASE     EQU     0x40007000
GPIO_O_DIR          EQU     0x00000400
GPIO_O_DR2R         EQU     0x00000500
GPIO_O_DEN          EQU     0x0000051C
GPIO_I_PUR          EQU     0x00000510

BROCHE6             EQU     0x40
BROCHE7             EQU     0x80
BROCHE6_7           EQU     0xC0

SWITCHES_DATA_BASE  EQU     0x20000200
SWITCH_SW_OFFSET    EQU     0x00 ;; On/off option
SWITCH_CNT_OFFSET   EQU     0x05 ;; Counter option
NEXT_SWITCH_OFFSET  EQU     0x10 ;; Right, left

FIRST_SWITCH_BASE    EQU     SWITCHES_DATA_BASE 
FIRST_SWITCH_ST_ADR  EQU     FIRST_SWITCH_BASE + SWITCH_SW_OFFSET
FIRST_SWITCH_CT_ADR  EQU     FIRST_SWITCH_BASE + SWITCH_CNT_OFFSET

SECOND_SWITCH_BASE   EQU     SWITCHES_DATA_BASE + NEXT_SWITCH_OFFSET 
SECOND_SWITCH_ST_ADR EQU     SECOND_SWITCH_BASE + SWITCH_SW_OFFSET
SECOND_SWITCH_CT_ADR EQU     SECOND_SWITCH_BASE + SWITCH_SW_OFFSET

		ENTRY
		EXPORT HANDLE_SWITCHES_INTERACTIONS
		EXPORT SWITCHES_INIT

		EXPORT SECOND_SWITCH_ST_ADR
		EXPORT SECOND_SWITCH_CT_ADR
		EXPORT FIRST_SWITCH_ST_ADR
		EXPORT FIRST_SWITCH_CT_ADR

		IMPORT INCR_VAL_STORED_IN_R1_ADR

		IMPORT LEDs_ON
		IMPORT LEDs_OFF

		IMPORT WAIT_R5_SECONDS

;; Initialization routine for switches
SWITCHES_INIT
		LDR r7, = GPIO_PORTD_BASE + GPIO_I_PUR
		LDR r0, = BROCHE6_7
		STR r0, [r7]
		
		LDR r7, = GPIO_PORTD_BASE + GPIO_O_DEN
		LDR r0, = BROCHE6_7
		STR r0, [r7]     
		
		PUSH {LR}
		BL INIT_SWITCHES_ADRESS
		POP {LR}
		
		BX LR

;; Set addresses related to switch usage to 0
INIT_SWITCHES_ADRESS
		MOV r0, #0
		; Load the address of FIRST_SWITCH_ST_ADR and store 0
		LDR r1, =FIRST_SWITCH_ST_ADR
		STR r0, [r1]

		; Load the address of SECOND_SWITCH_ST_ADR and store 0
		LDR r1, =SECOND_SWITCH_ST_ADR
		STR r0, [r1]

		; Load the address of FIRST_SWITCH_CT_ADR and store 0
		LDR r1, =FIRST_SWITCH_CT_ADR
		STR r0, [r1]

		; Load the address of SECOND_SWITCH_CT_ADR and store 0
		LDR r1, =SECOND_SWITCH_CT_ADR
		STR r0, [r1]
		
		BX LR

;; Handler for switch interactions
HANDLE_SWITCHES_INTERACTIONS
		PUSH {LR}
		BL FIRST_SWITCH_READSTATE
		
		LDR r1, =FIRST_SWITCH_ST_ADR
		LDR r2, [r1]
		
		CMP r2, #1
		BNE CHECK_NEXT_SWITCH
		
		BL LEDs_OFF
		BL INCR_FIRST_SWITCH_COUNTER
		
		MOV r5, #1
		BL WAIT_R5_SECONDS
		
		BL LEDs_ON

CHECK_NEXT_SWITCH
		BL SECOND_SWITCH_READSTATE
		
		LDR r1, =SECOND_SWITCH_ST_ADR
		LDR r2, [r1]
		
		CMP r2, #1
		BNE SECOND_SWITCH_NOT_PRESSED

SECOND_SWITCH_NOT_PRESSED
		POP {LR}
		BX LR

;; Read switch 1 state, set one in the dedicated state adress if is pressed, 0 if not
FIRST_SWITCH_READSTATE
		LDR r2, =FIRST_SWITCH_ST_ADR
		LDR r1, =GPIO_PORTD_BASE + (BROCHE6<<2)
		
		PUSH {LR}
		BL DEFINE_STATE
		POP {LR}
		BX LR

;; Read switch 2 state, set one in the dedicated state adress if is pressed, 0 if not
SECOND_SWITCH_READSTATE
		LDR r2, =SECOND_SWITCH_ST_ADR
		LDR r1, =GPIO_PORTD_BASE + (BROCHE7<<2)

DEFINE_STATE
		MOV r3, #0
		LDR r1, [r1]
		CMP r1, #0
		
		BNE leave1
		MOV r3, #1
leave1
		STR r3, [r2]
		
		BX LR

;; Increment FIRST_SWITCH_CT_ADR value
INCR_FIRST_SWITCH_COUNTER
		LDR r1, =FIRST_SWITCH_CT_ADR
		PUSH {LR}
		BL INCR_VAL_STORED_IN_R1_ADR
		POP {LR}
		
		BX LR

;; Increment SECOND_SWITCH_CT_ADR value
INCR_SECOND_SWITCH_COUNTER
		LDR r1, =SECOND_SWITCH_CT_ADR
		PUSH {LR}
		BL INCR_VAL_STORED_IN_R1_ADR
		POP {LR}
		
		BX LR

		;; End of the program
		END
